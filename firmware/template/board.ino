/*
  Home Control board firmware (common template)
  =============================================

  Every ESP32 runs this same sketch. Everything that differs per board is
  in board_config.h, which the app generates (Settings -> Boards ->
  Download code): board name, relays and their pins, Wi-Fi networks in
  priority order, and the board's cloud sign-in.

  - Joins the highest-priority Wi-Fi in range. Addresses come from the
    Wi-Fi (DHCP), so no static IP is needed on any network.
  - Cloud control through Supabase (cloud.h): the app switches it from
    any network. Relays restore their last state after a power cut.
  - Local HTTP API on port 80 for the same Wi-Fi:
      /status, /on, /off, /toggle (?relay=N)
      /timer?relay&action&seconds[&repeat], /timer/cancel?id= or ?relay=,
      /timers, /timer/clear[?relay=]
  - Up to 10 timers, kept by the board itself and saved in flash with their
    real end time, so they come back after a power cut or restart.
  - Reports why it last restarted (e.g. "power dip") in /status.

  Board: ESP32 Dev Module. Libraries: WebSockets (Markus Sattler),
  ArduinoJson.
*/

#include <WiFi.h>
#include <WebServer.h>
#include <esp_system.h>

#include "board_config.h"  // generated by the app; keep it private

#define CLOUD_RELAYS RELAY_COUNT
#include "cloud.h"


// ============================================================
// RELAYS
// ============================================================

bool relayState[RELAY_COUNT + 1];

void writeRelayPin(uint8_t relay, bool on) {
  bool high = RELAY_ACTIVE_LOW ? !on : on;
  digitalWrite(RELAY_PINS[relay - 1], high ? HIGH : LOW);
}

void setRelay(uint8_t relay, bool on) {

  if (relay < 1 || relay > RELAY_COUNT) {
    return;
  }

  bool changed = relayState[relay] != on;
  relayState[relay] = on;
  writeRelayPin(relay, on);

  if (changed) {
    cloudRelayChanged(relay, on);
  }
}

bool getRelayState(uint8_t relay) {
  return relay >= 1 && relay <= RELAY_COUNT && relayState[relay];
}


// ============================================================
// TIMERS
// ============================================================

#define MAX_TIMERS 10

struct TimerData {
  bool active;
  uint32_t id;
  uint8_t relay;
  bool actionOn;
  bool repeat;
  uint32_t seconds;
  unsigned long scheduledAt;
  unsigned long durationMs;
};

TimerData timers[MAX_TIMERS];
uint32_t nextTimerId = 1;

void saveTimers();  // SAVED TIMERS, below

int countActiveTimers() {
  int count = 0;
  for (int i = 0; i < MAX_TIMERS; i++) {
    if (timers[i].active) count++;
  }
  return count;
}

// Changes whenever a timer is created, cancelled or finishes, so the cloud
// report goes out straight away.
uint32_t cloudTimerSignature() {
  return nextTimerId * 16 + countActiveTimers();
}

int findTimerById(uint32_t id) {
  for (int i = 0; i < MAX_TIMERS; i++) {
    if (timers[i].active && timers[i].id == id) return i;
  }
  return -1;
}

// Returns the new timer's id, or 0 with *error set ("invalid" or "limit").
uint32_t createTimer(uint8_t relay, bool actionOn, uint32_t seconds, bool repeat, const char** error) {

  if (relay < 1 || relay > RELAY_COUNT || seconds < 1 || seconds > 86400) {
    *error = "invalid";
    return 0;
  }

  for (int i = 0; i < MAX_TIMERS; i++) {

    if (timers[i].active) continue;

    TimerData &t = timers[i];
    t.active = true;
    t.id = nextTimerId++;
    if (nextTimerId == 0) nextTimerId = 1;
    t.relay = relay;
    t.actionOn = actionOn;
    t.repeat = repeat;
    t.seconds = seconds;
    t.durationMs = seconds * 1000UL;
    t.scheduledAt = millis();
    saveTimers();
    return t.id;
  }

  *error = "limit";
  return 0;
}

bool cancelTimerById(uint32_t id) {
  int index = findTimerById(id);
  if (index == -1) return false;
  timers[index].active = false;
  saveTimers();
  return true;
}

// Returns how many were cancelled, or -1 for an unknown relay.
int cancelTimersOnRelay(uint8_t relay) {

  if (relay < 1 || relay > RELAY_COUNT) {
    return -1;
  }

  int cancelled = 0;
  for (int i = 0; i < MAX_TIMERS; i++) {
    if (timers[i].active && timers[i].relay == relay) {
      timers[i].active = false;
      cancelled++;
    }
  }
  if (cancelled > 0) saveTimers();
  return cancelled;
}

// Runs due timers. Repeating ones keep their rhythm without drifting.
void processTimers() {

  unsigned long now = millis();

  for (int i = 0; i < MAX_TIMERS; i++) {

    TimerData &t = timers[i];
    if (!t.active) continue;

    unsigned long elapsed = now - t.scheduledAt;
    if (elapsed < t.durationMs) continue;

    Serial.printf("Timer %lu: relay %u %s\n", (unsigned long)t.id, t.relay, t.actionOn ? "ON" : "OFF");
    setRelay(t.relay, t.actionOn);

    if (t.repeat) {
      unsigned long periods = elapsed / t.durationMs;
      t.scheduledAt += (periods == 0 ? 1 : periods) * t.durationMs;
    } else {
      t.active = false;
      saveTimers();
    }
  }
}

// Takes an index, not a TimerData: Arduino puts function prototypes above
// the struct, so a TimerData parameter wouldn't compile.
String timerToJSON(int index) {

  const TimerData &t = timers[index];
  unsigned long elapsed = millis() - t.scheduledAt;
  uint32_t remaining = elapsed < t.durationMs ? (t.durationMs - elapsed + 999) / 1000 : 0;

  String json = "{\"active\":true";
  json += ",\"id\":" + String(t.id);
  json += ",\"relay\":" + String(t.relay);
  json += ",\"action\":\"" + String(t.actionOn ? "on" : "off") + "\"";
  json += ",\"repeat\":" + String(t.repeat ? "true" : "false");
  json += ",\"seconds\":" + String(t.seconds);
  json += ",\"remaining\":" + String(remaining);
  json += "}";
  return json;
}

String timersJSON() {

  String json = "[";
  bool first = true;

  for (int i = 0; i < MAX_TIMERS; i++) {
    if (!timers[i].active) continue;
    if (!first) json += ",";
    json += timerToJSON(i);
    first = false;
  }

  return json + "]";
}


// ============================================================
// SAVED TIMERS (survive a power cut or restart)
// ============================================================
// Each timer is saved with its real end time from the internet clock. After
// a restart it's put back once the clock is known. A timer that should have
// fired while the board was off runs its action at once if it's at most
// 10 minutes late; an older one-shot timer is dropped. Repeating timers
// carry on in rhythm.

Preferences timerPrefs;

const long TIMER_LATE_LIMIT_S = 600;

struct SavedTimer {
  uint32_t id;
  uint32_t seconds;
  uint32_t dueEpoch;  // next time it fires, in Unix time
  uint8_t relay;
  uint8_t flags;      // 1 = action ON, 2 = repeat
  uint8_t pad[2];
};

bool timersRestored = false;
int timersBack = 0;      // put back after the restart
int timersLate = 0;      // missed while off, run on restart
int timersDropped = 0;   // missed by too long, not run

bool clockKnown() {
  return time(nullptr) > 1700000000;
}

void saveTimers() {

  // Until the saved ones are back, saving would overwrite them.
  if (!timersRestored || !clockKnown()) return;

  SavedTimer list[MAX_TIMERS];
  int n = 0;
  time_t now = time(nullptr);
  unsigned long ms = millis();

  for (int i = 0; i < MAX_TIMERS; i++) {
    const TimerData &t = timers[i];
    if (!t.active) continue;
    unsigned long elapsed = ms - t.scheduledAt;
    uint32_t left = elapsed < t.durationMs ? (t.durationMs - elapsed + 999) / 1000 : 0;
    list[n++] = { t.id, t.seconds, (uint32_t)(now + left), t.relay, (uint8_t)((t.actionOn ? 1 : 0) | (t.repeat ? 2 : 0)), { 0, 0 } };
  }

  timerPrefs.putUInt("next", nextTimerId);
  if (n > 0) timerPrefs.putBytes("list", list, n * sizeof(SavedTimer));
  else timerPrefs.remove("list");
}

void restoreTimers() {

  timersRestored = true;

  uint32_t savedNext = timerPrefs.getUInt("next", 1);
  if (savedNext > nextTimerId) nextTimerId = savedNext;

  SavedTimer list[MAX_TIMERS];
  int n = timerPrefs.getBytesLength("list") / sizeof(SavedTimer);
  if (n > MAX_TIMERS) n = MAX_TIMERS;
  if (n > 0) timerPrefs.getBytes("list", list, n * sizeof(SavedTimer));

  time_t now = time(nullptr);

  for (int k = 0; k < n; k++) {

    const SavedTimer &s = list[k];
    bool on = s.flags & 1;
    bool repeat = s.flags & 2;
    long late = (long)(now - (time_t)s.dueEpoch);  // > 0: should already have fired
    uint32_t left;

    if (late > 0) {
      if (late <= TIMER_LATE_LIMIT_S) {
        Serial.printf("Timer %lu missed by %lds: relay %u %s now\n", (unsigned long)s.id, late, s.relay, on ? "ON" : "OFF");
        setRelay(s.relay, on);
        timersLate++;
      } else if (!repeat) {
        Serial.printf("Timer %lu missed by %lds: dropped\n", (unsigned long)s.id, late);
        timersDropped++;
      }
      if (!repeat || s.seconds == 0) continue;
      left = s.seconds - (uint32_t)(late % s.seconds);
    } else {
      left = (uint32_t)(-late);
      if (left == 0) left = 1;
    }

    int slot = -1;
    for (int i = 0; i < MAX_TIMERS; i++) {
      if (!timers[i].active) { slot = i; break; }
    }
    if (slot == -1) break;

    TimerData &t = timers[slot];
    t.active = true;
    t.id = findTimerById(s.id) == -1 ? s.id : nextTimerId++;
    t.relay = s.relay;
    t.actionOn = on;
    t.repeat = repeat;
    t.seconds = s.seconds;
    // Repeating: keep the period, start part-way through it. One-shot: what's left.
    t.durationMs = (repeat ? s.seconds : left) * 1000UL;
    t.scheduledAt = millis() - (repeat ? (s.seconds - left) * 1000UL : 0);
    timersBack++;
  }

  Serial.printf("Timers after restart: %d back, %d run late, %d dropped\n", timersBack, timersLate, timersDropped);
  saveTimers();
}


// ============================================================
// WHY IT LAST RESTARTED
// ============================================================

const char* resetReason = "unknown";
uint32_t bootCount = 0;

const char* describeReset(esp_reset_reason_t r) {
  switch (r) {
    case ESP_RST_POWERON: return "power on";
    case ESP_RST_EXT: return "reset button";
    case ESP_RST_SW: return "software restart";
    case ESP_RST_PANIC: return "crash";
    case ESP_RST_INT_WDT:
    case ESP_RST_TASK_WDT:
    case ESP_RST_WDT: return "watchdog (stuck)";
    case ESP_RST_DEEPSLEEP: return "deep sleep";
    case ESP_RST_BROWNOUT: return "power dip";
    default: return "unknown";
  }
}


// ============================================================
// STATUS
// ============================================================

String jsonText(const String &value) {

  String out = "\"";
  for (unsigned int i = 0; i < value.length(); i++) {
    char c = value[i];
    if (c == '"' || c == '\\') out += '\\';
    if ((uint8_t)c >= 0x20) out += c;
  }
  return out + "\"";
}

String getStatusJSON() {

  String json = "{\"ok\":true,\"timerApi\":2";
  json += ",\"device\":" + jsonText(BOARD_ID);
  json += ",\"name\":" + jsonText(BOARD_NAME);

  json += ",\"relays\":[";
  for (uint8_t r = 1; r <= RELAY_COUNT; r++) {
    if (r > 1) json += ",";
    json += "{\"relay\":" + String(r) + ",\"power\":\"" + (relayState[r] ? "on" : "off") + "\"}";
  }
  json += "]";

  for (uint8_t r = 1; r <= RELAY_COUNT; r++) {
    json += ",\"relay" + String(r) + "\":" + (relayState[r] ? "true" : "false");
  }

  json += ",\"timers\":" + timersJSON();
  json += ",\"uptime\":" + String(millis() / 1000);
  json += ",\"ip\":" + jsonText(WiFi.localIP().toString());
  json += ",\"ssid\":" + jsonText(WiFi.SSID());
  json += ",\"rssi\":" + String(WiFi.RSSI());
  json += ",\"cloud\":" + jsonText(cloudState);
  json += ",\"reset\":" + jsonText(resetReason);
  json += ",\"boots\":" + String(bootCount);
  if (timersRestored) {
    json += ",\"timersAfterRestart\":{\"back\":" + String(timersBack) + ",\"late\":" + String(timersLate) + ",\"dropped\":" + String(timersDropped) + "}";
  }
  json += ",\"acks\":" + cloudAcksJSON();
  json += "}";
  return json;
}


// ============================================================
// WEB SERVER (same Wi-Fi only)
// ============================================================

WebServer server(80);

void addCORS() {
  server.sendHeader("Access-Control-Allow-Origin", "*");
  server.sendHeader("Access-Control-Allow-Methods", "GET, OPTIONS");
  server.sendHeader("Access-Control-Allow-Headers", "*");
}

void sendJSON(int code, const String &json) {
  addCORS();
  server.send(code, "application/json", json);
}

void sendError(int code, const char* error) {
  sendJSON(code, String("{\"ok\":false,\"error\":\"") + error + "\"}");
}

// ?relay=N (defaults to 1). Returns 0 and answers 400 if it's not a relay.
uint8_t relayArg() {
  int relay = server.hasArg("relay") ? server.arg("relay").toInt() : 1;
  if (relay < 1 || relay > RELAY_COUNT) {
    sendError(400, "invalid relay");
    return 0;
  }
  return relay;
}

void handleRoot() {
  addCORS();
  server.send(200, "text/plain", String(BOARD_NAME) + " (" + BOARD_ID + ") is running. See /status.");
}

void handleStatus() {
  sendJSON(200, getStatusJSON());
}

void handleSwitch(int mode) {  // 1 on, 0 off, -1 toggle

  uint8_t relay = relayArg();
  if (!relay) return;

  bool on = mode == -1 ? !relayState[relay] : mode == 1;
  setRelay(relay, on);
  sendJSON(200, "{\"ok\":true,\"relay\":" + String(relay) + ",\"state\":\"" + (on ? "on" : "off") + "\"}");
}

void handleTimer() {

  if (!server.hasArg("action") || !server.hasArg("seconds")) {
    sendError(400, "relay, action and seconds required");
    return;
  }

  uint8_t relay = relayArg();
  if (!relay) return;

  String action = server.arg("action");
  action.toLowerCase();
  if (action != "on" && action != "off") {
    sendError(400, "action must be on or off");
    return;
  }

  String repeatArg = server.arg("repeat");
  repeatArg.toLowerCase();
  bool repeat = repeatArg == "true" || repeatArg == "1";

  const char* error = "invalid";
  uint32_t id = createTimer(relay, action == "on", server.arg("seconds").toInt(), repeat, &error);

  if (!id) {
    if (strcmp(error, "limit") == 0) sendError(409, "maximum 10 timers active");
    else sendError(400, "seconds must be between 1 and 86400");
    return;
  }

  int index = findTimerById(id);
  sendJSON(200, "{\"ok\":true,\"relay\":" + String(relay) + ",\"timer\":" + timerToJSON(index) + "}");
}

void handleTimerCancel() {

  if (server.hasArg("id")) {
    uint32_t id = server.arg("id").toInt();
    if (!cancelTimerById(id)) {
      sendError(404, "timer not found");
      return;
    }
    sendJSON(200, "{\"ok\":true,\"cancelled\":" + String(id) + "}");
    return;
  }

  if (server.hasArg("relay")) {
    uint8_t relay = relayArg();
    if (!relay) return;
    int cancelled = cancelTimersOnRelay(relay);
    sendJSON(200, "{\"ok\":true,\"relay\":" + String(relay) + ",\"cancelled\":" + String(cancelled) + "}");
    return;
  }

  sendError(400, "id or relay required");
}

void handleTimers() {
  sendJSON(200, "{\"ok\":true,\"timers\":" + timersJSON() + "}");
}

// Respects ?relay; without it, clears every relay's timers.
void handleTimerClear() {

  int cancelled = 0;

  if (server.hasArg("relay")) {
    uint8_t relay = relayArg();
    if (!relay) return;
    cancelled = cancelTimersOnRelay(relay);
  } else {
    for (uint8_t r = 1; r <= RELAY_COUNT; r++) cancelled += cancelTimersOnRelay(r);
  }

  sendJSON(200, "{\"ok\":true,\"cancelled\":" + String(cancelled) + "}");
}

void handleOptions() {
  addCORS();
  server.send(204);
}

void setupRoutes() {

  server.on("/", HTTP_GET, handleRoot);
  server.on("/status", HTTP_GET, handleStatus);
  server.on("/on", HTTP_GET, []() { handleSwitch(1); });
  server.on("/off", HTTP_GET, []() { handleSwitch(0); });
  server.on("/toggle", HTTP_GET, []() { handleSwitch(-1); });
  server.on("/timer", HTTP_GET, handleTimer);
  server.on("/timer/cancel", HTTP_GET, handleTimerCancel);
  server.on("/timers", HTTP_GET, handleTimers);
  server.on("/timer/clear", HTTP_GET, handleTimerClear);
  server.on("/timers/clear", HTTP_GET, handleTimerClear);

  server.onNotFound([]() {
    if (server.method() == HTTP_OPTIONS) handleOptions();
    else sendError(404, "not found");
  });
}


// ============================================================
// WI-FI (priority order from the app)
// ============================================================

unsigned long wifiLostAt = 0;
const unsigned long WIFI_RETRY_MS = 10000;

bool tryNetwork(int index, unsigned long timeoutMs) {

  const WifiNetwork &net = WIFI_NETWORKS[index];
  Serial.printf("Wi-Fi %d/%d: %s ", index + 1, WIFI_COUNT, net.ssid);

  WiFi.disconnect(false, false);
  delay(200);
  WiFi.config(INADDR_NONE, INADDR_NONE, INADDR_NONE);  // address from the Wi-Fi (DHCP)
  WiFi.begin(net.ssid, net.password);

  unsigned long start = millis();
  while (WiFi.status() != WL_CONNECTED && millis() - start < timeoutMs) {
    delay(250);
    Serial.print(".");
  }

  if (WiFi.status() == WL_CONNECTED) {
    Serial.printf(" connected, IP %s\n", WiFi.localIP().toString().c_str());
    return true;
  }

  Serial.println(" failed");
  return false;
}

// Joins the highest-priority network that's in range. Networks not seen in
// the scan (e.g. hidden ones) are tried last.
bool connectWiFi() {

  Serial.println("Scanning for Wi-Fi...");
  int found = WiFi.scanNetworks();
  bool visible[WIFI_COUNT];

  for (int i = 0; i < WIFI_COUNT; i++) {
    visible[i] = false;
    for (int j = 0; j < found; j++) {
      if (WiFi.SSID(j) == WIFI_NETWORKS[i].ssid) {
        visible[i] = true;
        break;
      }
    }
  }
  WiFi.scanDelete();

  for (int i = 0; i < WIFI_COUNT; i++) {
    if (visible[i] && tryNetwork(i, 15000)) return true;
  }
  for (int i = 0; i < WIFI_COUNT; i++) {
    if (!visible[i] && tryNetwork(i, 8000)) return true;
  }

  Serial.println("No Wi-Fi network available.");
  return false;
}


// ============================================================
// SETUP / LOOP
// ============================================================

void setup() {

  Serial.begin(115200);
  delay(300);
  timerPrefs.begin("timers", false);
  resetReason = describeReset(esp_reset_reason());
  bootCount = timerPrefs.getUInt("boots", 0) + 1;
  timerPrefs.putUInt("boots", bootCount);

  Serial.printf("\n%s (%s): %d relay(s), %d Wi-Fi network(s)\n", BOARD_NAME, BOARD_ID, RELAY_COUNT, WIFI_COUNT);
  Serial.printf("Start #%lu, last restart: %s\n", (unsigned long)bootCount, resetReason);

  for (uint8_t r = 1; r <= RELAY_COUNT; r++) {
    pinMode(RELAY_PINS[r - 1], OUTPUT);
    relayState[r] = false;
    writeRelayPin(r, false);
  }

  for (int i = 0; i < MAX_TIMERS; i++) {
    timers[i].active = false;
  }

  cloudBegin();  // restores each relay's last state

  WiFi.mode(WIFI_STA);
  WiFi.setAutoReconnect(true);
  WiFi.persistent(false);
  WiFi.setSleep(false);
  connectWiFi();

  setupRoutes();
  server.begin();
  Serial.println("Ready.");
}

void loop() {

  server.handleClient();

  // Saved timers come back once the internet clock is known.
  if (!timersRestored && clockKnown()) {
    restoreTimers();
  }

  processTimers();
  cloudLoop();

  // Lost Wi-Fi for 10 s: start again from the highest priority.
  if (WiFi.status() != WL_CONNECTED) {
    if (wifiLostAt == 0) wifiLostAt = millis();
    if (millis() - wifiLostAt >= WIFI_RETRY_MS) {
      connectWiFi();
      wifiLostAt = 0;
    }
  } else {
    wifiLostAt = 0;
  }

  delay(1);
}
